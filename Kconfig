## Kconfig
```kconfig
config LISM_INPUT_PROCESSOR_POINTER_ACCEL
    bool "LisM pointer acceleration input processor"
    default y
    depends on DT_HAS_LISM_INPUT_PROCESSOR_POINTER_ACCEL_ENABLED
    help
      Scale relative pointer movement from a base CPI to a maximum effective
      CPI according to the size of each movement event.

config LISM_INPUT_PROCESSOR_AXIS_LOCK
    bool "LisM dominant-axis lock input processor"
    default y
    depends on DT_HAS_LISM_INPUT_PROCESSOR_AXIS_LOCK_ENABLED
    help
      Select the dominant pointer axis at the start of a gesture and suppress
      movement on the other axis until the gesture becomes idle.
```

## config/west.yml
```yaml
manifest:
  remotes:
    - name: zmkfirmware
      url-base: https://github.com/zmkfirmware
    - name: sekigon-gonnoc
      url-base: https://github.com/sekigon-gonnoc
    - name: caksoylar
      url-base: https://github.com/caksoylar
    - name: 4mplelab
      url-base: https://github.com/4mplelab
    - name: cormoran
      url-base: https://github.com/cormoran
  projects:
    - name: zmk
      remote: cormoran
      revision: v0.3-branch+dya
      import: app/west.yml
    - name: zmk-module-runtime-input-processor
      remote: cormoran
      revision: zmk-v0.3.0.0
    - name: zmk-driver-paw3222
      remote: sekigon-gonnoc
      revision: main
    - name: zmk-rgbled-widget
      remote: caksoylar
      revision: v0.3
    - name: zmk-feature-charge-indicator
      remote: 4mplelab
      revision: main
  self:
    path: config
```

## dts/bindings/input_processors/lism,input-processor-axis-lock.yaml
```yaml
description: LisM input processor for gesture-based dominant-axis locking

compatible: "lism,input-processor-axis-lock"

include: ip_zero_param.yaml

properties:
  decision-threshold:
    type: int
    required: true
    description: Total absolute X/Y movement required before selecting an axis

  unlock-timeout-ms:
    type: int
    required: true
    description: Idle time in milliseconds before selecting a new axis
```

## dts/bindings/input_processors/lism,input-processor-pointer-accel.yaml
```yaml
description: LisM input processor for movement-dependent pointer acceleration

compatible: "lism,input-processor-pointer-accel"

include: ip_zero_param.yaml

properties:
  base-cpi:
    type: int
    required: true
    description: Effective CPI used for movement at or below accel-start

  max-cpi:
    type: int
    required: true
    description: Effective CPI used for movement at or above accel-full

  accel-start:
    type: int
    required: true
    description: Absolute event value where acceleration starts

  accel-full:
    type: int
    required: true
    description: Absolute event value where maximum acceleration is reached
```
